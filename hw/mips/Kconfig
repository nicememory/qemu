## hw/mips/Kconfig
```kconfig
config MALTA
    bool
    select ISA_SUPERIO

config MIPSSIM
    bool
    select ISA_BUS
    select SERIAL_ISA
    select MIPSNET

config JAZZ
    bool
    select ISA_BUS
    select RC4030
    select I8259
    select I8254
    select I8257
    select PCSPK
    select VGA_ISA_MM
    select G364FB
    select DP8393X
    select ESP
    select FDC_SYSBUS
    select MC146818RTC
    select PCKBD
    select SERIAL
    select PARALLEL
    select DS1225Y
    select JAZZ_LED

config FULOONG
    bool
    select PCI_BONITO

config LOONGSON3V
    bool
    imply VIRTIO_VGA
    imply QXL if SPICE
    select SERIAL
    select GOLDFISH_RTC
    select LOONGSON_LIOINTC
    select PCI_DEVICES
    select PCI_EXPRESS_GENERIC_BRIDGE
    select MSI_NONBROKEN
    select FW_CFG_MIPS

config LOONGSON3_7A1K
    bool
    imply VIRTIO_VGA
    imply QXL if SPICE
    select SERIAL
    select I2C
    select LS7A1K_RTC
    select DS1338
    select HDA
    select PCI_EXPRESS_LS7A1K
    select LOONGSON_I2C
    select LOONGSON_GPIO
    select LOONGSON_IPI
    select LOONGSON_SPI
    select LOONGSON_EXTIOI
    select LOONGSON_PCH_PIC
    select LOONGSON_PCH_MSI
    select FW_CFG_MIPS

config LOONGSON3B4KV
    bool
    imply VIRTIO_VGA
    imply QXL if SPICE
    select SERIAL
    select GOLDFISH_RTC
    select LOONGSON_LIOINTC
    select LOONGSON_IPI
    select PCI_DEVICES
    select PCI_EXPRESS_GENERIC_BRIDGE
    select MSI_NONBROKEN
    select FW_CFG_MIPS

config MIPS_CPS
    bool
    select PTIMER
    select MIPS_ITU

config MIPS_BOSTON
    bool
    select FITLOADER
    select MIPS_CPS
    select PCI_EXPRESS_XILINX
    select AHCI_ICH9
    select SERIAL

config FW_CFG_MIPS
    bool
```
